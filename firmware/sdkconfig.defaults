## firmware/sdkconfig.defaults
```kconfig
# CPU
CONFIG_ESP_DEFAULT_CPU_FREQ_MHZ_240=y

# PSRAM (camera framebuffer only — model must NOT use this)
CONFIG_SPIRAM=y
CONFIG_SPIRAM_MODE_OCT=y
CONFIG_SPIRAM_SPEED_80M=y

# Camera on Core 0
CONFIG_CAMERA_TASK_PINNED_TO_CORE_0=y

# Dual-core (inference on Core 1)
CONFIG_FREERTOS_UNICORE=n

# Optimization
CONFIG_COMPILER_OPTIMIZATION_PERF=y
CONFIG_ESP_SYSTEM_MEMPROT_FEATURE=n
CONFIG_PARTITION_TABLE_CUSTOM=y
CONFIG_PARTITION_TABLE_CUSTOM_FILENAME="partitions.csv"
```
